#include <SPI.h>
#include <Wire.h>
#include <Adafruit_GFX.h>
#include <Adafruit_SSD1306.h>
#include <WiFi.h>
#include <WiFiManager.h>
#include <PubSubClient.h>

#define OLED_RESET -1
Adafruit_SSD1306 display(OLED_RESET);

char buffer[5];
int cout = 13;
int couta = 0;
int coutb = 0;

float R0 = 80.0;
float RL = 10.0;
float Vc = 3.3;

String SSIDWIFI;

const char* mqtt_server = "broker.netpie.io";
const int mqtt_port = 1883;
const char* mqtt_Client = "77419f5d-e53f-40e2-928c-4633126bc2fb";
const char* mqtt_username = "4LvZ6yCqqddCsenNUuyf9jsbxV2UcZhe";
const char* mqtt_password = "pCVthYtq8tEPEfr1iC6Cf4V7bbHQtac3";

WiFiClient espClient;
PubSubClient client(espClient);
char msg[50];

const unsigned char wifi[] PROGMEM = {
  0x02, 0x02, 0x0a, 0x0a, 0x2a, 0x2a, 0xaa, 0x00
};

const unsigned char happy_face[] PROGMEM = {
  0x0f, 0x00, 0x00, 0x00, 0x0f, 0x00, 0x1f, 0xf0, 0x00, 0x00, 0xff, 0x80, 0x19, 0xfc, 0x00, 0x03,
  0xf9, 0x80, 0x30, 0x7f, 0x00, 0x0f, 0xe0, 0xc0, 0x30, 0x3f, 0xff, 0xff, 0xc0, 0xc0, 0x30, 0x3c,
  0x00, 0x03, 0xc0, 0xc0, 0x30, 0x00, 0x00, 0x00, 0x00, 0xc0, 0x30, 0x00, 0x00, 0x00, 0x00, 0xc0,
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  0xff, 0xf8, 0x00, 0x00
};

const unsigned char neutral_face[] PROGMEM = {
  0x0f, 0x00, 0x00, 0x00, 0x0f, 0x00, 0x1f, 0xf0, 0x00, 0x00, 0xff, 0x80, 0x19, 0xfc, 0x00, 0x03,
  0xf9, 0x80, 0x30, 0x7f, 0x00, 0x0f, 0xe0, 0xc0, 0x30, 0x3f, 0xff, 0xff, 0xc0, 0xc0, 0x30, 0x3c,
  0x00, 0x03, 0xc0, 0xc0, 0x30, 0x00, 0x00, 0x00, 0x00, 0xc0, 0x30, 0x00, 0x00, 0x00, 0x00, 0xc0,
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  0xff, 0xf8, 0x00, 0x00
};

const unsigned char sad_face[] PROGMEM = {
  0x0f, 0x00, 0x00, 0x00, 0x0f, 0x00, 0x1f, 0xf0, 0x00, 0x00, 0xff, 0x80, 0x19, 0xfc, 0x00, 0x03,
  0xf9, 0x80, 0x30, 0x7f, 0x00, 0x0f, 0xe0, 0xc0, 0x30, 0x3f, 0xff, 0xff, 0xc0, 0xc0, 0x30, 0x3c,
  0x00, 0x03, 0xc0, 0xc0, 0x30, 0x00, 0x00, 0x00, 0x00, 0xc0, 0x30, 0x00, 0x00, 0x00, 0x00, 0xc0,
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  0xff, 0xf8, 0x00, 0x00
};

const unsigned char cute_cat_0[] PROGMEM = {
  0x00, 0x00, 0x00, 0x00, 0x00, 0x00, 0x00, 0x00, 0x00, 0x00, 0x00, 0x00, 0x00, 0x00, 0x00, 0x00,
  0x00, 0x00, 0x00, 0x00, 0x00, 0x00, 0x00, 0x00, 0x00, 0x00, 0x00, 0x00, 0x00, 0x00, 0x00, 0x00,
  0x00, 0x00, 0x00, 0x00, 0x00, 0x00, 0x00, 0x00, 0x00, 0x00, 0x00, 0x00, 0x00, 0x00, 0x00, 0x00,
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  0x00, 0x00, 0x00, 0x00, 0x00, 0x00, 0x00, 0x00, 0x00, 0x00, 0x00, 0x00, 0x00, 0x00, 0x00, 0x00
};

const unsigned char cute_cat_1[] PROGMEM = {
  0x00, 0x00, 0x00, 0x00, 0x00, 0x00, 0x00, 0x00, 0x00, 0x00, 0x00, 0x00, 0x00, 0x00, 0x00, 0x00,
  0x00, 0x00, 0x00, 0x00, 0x00, 0x00, 0x00, 0x00, 0x00, 0x00, 0x00, 0x00, 0x00, 0x00, 0x00, 0x00,
  0x00, 0x00, 0x00, 0x00, 0x00, 0x00, 0x00, 0x00, 0x00, 0x00, 0x00, 0x00, 0x00, 0x00, 0x00, 0x00,
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  0x00, 0x00, 0x00, 0x00, 0x00, 0x00, 0x00, 0x00, 0x00, 0x00, 0x00, 0x00, 0x00, 0x00, 0x00, 0x00
};

const unsigned char cute_cat_2[] PROGMEM = {
  0x00, 0x00, 0x00, 0x00, 0x00, 0x00, 0x00, 0x00, 0x00, 0x00, 0x00, 0x00, 0x00, 0x00, 0x00, 0x00,
  0x00, 0x00, 0x00, 0x00, 0x00, 0x00, 0x00, 0x00, 0x00, 0x00, 0x00, 0x00, 0x00, 0x00, 0x00, 0x00,
  0x00, 0x00, 0x00, 0x00, 0x00, 0x00, 0x00, 0x00, 0x00, 0x00, 0x00, 0x00, 0x00, 0x00, 0x00, 0x00,
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  0x00, 0x00, 0x00, 0x00, 0x00, 0xe0, 0x00, 0x00, 0x00, 0x00, 0x00, 0x00, 0x00, 0x00, 0x00, 0x00
};

const unsigned char wifi_l[] PROGMEM = {
  0x00, 0x00, 0x07, 0xfc, 0x00, 0x00, 0xff, 0xfe, 0x00, 0x0f, 0xfe, 0x00, 0x00, 0x3f, 0x80, 0x00,
  0x00, 0xfc, 0x00, 0x00, 0x03, 0xf0, 0x00, 0x00, 0x07, 0xc0, 0x07, 0xfe, 0x1f, 0x00, 0x7f, 0xfe,
  0x3e, 0x01, 0xf8, 0x00, 0x3c, 0x03, 0xe0, 0x00, 0x7c, 0x07, 0xc0, 0x00, 0x78, 0x0f, 0x80, 0xf8,
  0x78, 0x0f, 0x81, 0xfc, 0x78, 0x0f, 0x80, 0xfc, 0x38, 0x07, 0x00, 0x00
};

float cPPM(float rat, float b, float s) {
  return pow(10, (log10(rat) - b) / s);
}

void disp(String name, float ppm) {
  display.fillRect(0, 0, display.width(), 8, BLACK);
  display.setTextSize(1);
  display.setTextColor(WHITE, BLACK);
  display.setCursor(0, 0);
  display.println(name);

  display.setTextSize(2);
  display.setTextColor(WHITE, BLACK);
  display.setCursor(0, 8);
  display.println(ppm);

  display.fillRect(48, 13, 19, 9, WHITE);
  display.setTextSize(1);
  display.setTextColor(BLACK);
  display.setCursor(49, 14);
  display.println("PPM");
}

void text(int text) {
  if (text == 0) {
    display.fillRect(65, 1, 7, 9, WHITE);
    display.setTextSize(1);
    display.setTextColor(BLACK);
    display.setCursor(66, 2);
    display.println("C");

    display.setTextColor(WHITE);
    display.setCursor(73, 2);
    display.println("limate");
  } else if (text == 1) {
    display.fillRect(65, 11, 7, 9, WHITE);
    display.setTextSize(1);
    display.setTextColor(BLACK);
    display.setCursor(66, 12);
    display.println("A");

    display.setTextColor(WHITE);
    display.setCursor(73, 12);
    display.println("nalysis");
  } else if (text == 2) {
    display.fillRect(65, 21, 7, 9, WHITE);
    display.setTextSize(1);
    display.setTextColor(BLACK);
    display.setCursor(66, 22);
    display.println("T");

    display.setTextColor(WHITE);
    display.setCursor(73, 22);
    display.println("ool");
  }
}

void setup() {
  // put your setup code here, to run once:
  Serial.begin(115200);
  display.begin(SSD1306_SWITCHCAPVCC, 0x3C);
  display.clearDisplay();
  display.drawBitmap(64, 0, cute_cat_0, 64, 32, WHITE);
  display.display();
  display.startscrollleft(0x00, 0x07);
  delay(2000);
  display.stopscroll();
  display.clearDisplay();
  display.drawBitmap(0, 0, cute_cat_1, 64, 32, WHITE);
  text(0);
  display.display();
  delay(500);

  display.clearDisplay();
  display.drawBitmap(0, 0, cute_cat_2, 64, 32, WHITE);
  text(1);
  display.display();
  delay(500);

  display.clearDisplay();
  display.drawBitmap(0, 0, cute_cat_1, 64, 32, WHITE);
  text(2);
  display.display();
  delay(500);

  display.clearDisplay();
  display.drawBitmap(0, 0, cute_cat_0, 64, 32, WHITE);
  text(0);
  text(1);
  text(2);
  display.display();
  delay(1500);

  display.clearDisplay();
  display.drawBitmap(96, 0, wifi_l, 32, 15, WHITE);
  display.setTextSize(1);
  display.setTextColor(WHITE);
  display.setCursor(0, 0);
  display.println("Select Wi-Fi");
  display.setCursor(0, 8);
  display.println("to connet");
  display.setCursor(0, 16);
  display.println("SSID: C.A.T-connect");
  display.setCursor(0, 24);
  display.println("PASS: Cat14785");
  display.display();
  WiFiManager wm;
  bool res;
  wm.setConfigPortalTimeout(60);
  wm.setConnectTimeout(10);
  res = wm.autoConnect("C.A.T-connect", "Cat14785");
  if (!res) {
    Serial.println("Failed to connect");
    SSIDWIFI = "Offline";
    display.clearDisplay();
    display.fillRect(0, 8, display.width(), 23, WHITE);
    display.setTextColor(WHITE);
    display.setCursor(1, 0);
    display.setTextSize(1);
    display.println("Status :");
    display.setTextColor(BLACK);
    display.setCursor(1, 9);
    display.setTextSize(3);
    display.println("Offline");
    display.display();
    delay(1000);
  } else {
    Serial.println("connected...yeey :)");
    SSIDWIFI = WiFi.SSID();
    display.clearDisplay();
    display.fillRect(0, 8, display.width(), 23, WHITE);
    display.setTextColor(WHITE);
    display.setCursor(1, 0);
    display.setTextSize(1);
    display.println("Status :");
    display.setTextColor(BLACK);
    display.setCursor(1, 9);
    display.setTextSize(3);
    display.println("Online");
    display.display();
    delay(1000);
  }
  display.clearDisplay();

  client.setServer(mqtt_server, mqtt_port);
  client.connect(mqtt_Client, mqtt_username, mqtt_password);
  client.subscribe("@msg/txt");
}

void loop() {
  client.loop();

  int sensor_value = analogRead(33);
  float Vo = (sensor_value / 4095.0) * Vc;
  float Rs = ((Vc - Vo) / Vo) * RL;
  float ratio = Rs / R0;

  float NH3 = cPPM(ratio, -0.42, -1.7);
  float CO2 = cPPM(ratio, 0.38, -2.9);
  float CO = cPPM(ratio, 0.50, -2.8);
  float C2H50H = cPPM(ratio, 0.34, -3.4);
  float C6H6 = cPPM(ratio, 1.3, -3.5);
  float C7H8 = cPPM(ratio, 1.5, -3.5);

  Serial.print("Sensor Value: ");
  Serial.println(sensor_value);
  Serial.print("WiFi Status: ");
  if (WiFi.status() == WL_CONNECTED) {
    Serial.println("Online");
  } else {
    Serial.println("Offline");
    SSIDWIFI = "Offline";
  }

  sprintf(buffer, "%04d", sensor_value);

  if (couta < 6) {
    display.fillRect(0, 0, display.width(), 8, BLACK);
    display.setTextSize(1);
    display.setTextColor(WHITE, BLACK);
    display.setCursor(0, 0);
    display.println("Sensor Value:");

    display.setTextSize(2);
    display.setTextColor(WHITE, BLACK);
    display.setCursor(0, 8);
    display.println(buffer);
    display.fillRect(48, 13, 19, 9, BLACK);
  } else if (couta < 12) {
    disp("Ammonia:", NH3);
  } else if (couta < 18) {
    disp("Carbon dioxide:", CO2);
  } else if (couta < 24) {
    disp("Carbon monoxide:", CO);
  } else if (couta < 30) {
    disp("Alcohol:", C2H50H);
  } else if (couta < 36) {
    disp("Benzene:", C6H6);
  } else if (couta < 42) {
    disp("Toluene:", C7H8);
  } else {
    couta = 0;
  }

  display.fillRect(84, 0, 44, 22, BLACK);

  if (sensor_value < 600) {
    display.drawBitmap(84, 0, happy_face, 44, 22, WHITE);
  } else if (sensor_value < 900) {
    display.drawBitmap(84, 0, neutral_face, 44, 22, WHITE);
  } else {
    display.drawBitmap(84, 0, sad_face, 44, 22, WHITE);
  }

  if (cout > -128) {
    display.fillRect(0, 24, display.width(), 8, BLACK);
    display.setTextSize(1);
    display.setTextColor(WHITE, BLACK);
    display.setCursor(cout, 24);
    display.println(SSIDWIFI);
    display.fillRect(0, 24, 10, 8, BLACK);
    display.drawBitmap(0, 24, wifi, 8, 8, WHITE);
  } else {
    cout = 128;
  }

  display.display();

  if (coutb > 15) {
    String data = String(sensor_value);
    data.toCharArray(msg, (data.length() + 1));
    client.publish("@msg/sv", msg);

    data = String(NH3);
    data.toCharArray(msg, (data.length() + 1));
    client.publish("@msg/NH3", msg);

    data = String(CO2);
    data.toCharArray(msg, (data.length() + 1));
    client.publish("@msg/CO2", msg);

    data = String(CO);
    data.toCharArray(msg, (data.length() + 1));
    client.publish("@msg/CO", msg);

    data = String(C2H50H);
    data.toCharArray(msg, (data.length() + 1));
    client.publish("@msg/C2H50H", msg);

    data = String(C6H6);
    data.toCharArray(msg, (data.length() + 1));
    client.publish("@msg/C6H6", msg);

    data = String(C7H8);
    data.toCharArray(msg, (data.length() + 1));
    client.publish("@msg/C7H8", msg);
    coutb = 0;
  }

  delay(500);
  cout -= 8;
  couta += 1;
  coutb += 1;
}